## components/CommandCenter/Kconfig
```kconfig
menu "Command Center Config"

config CUT_DWN_GPIO
  int "Cut Down GPIO pin"
  range 0 39
  default 35
  help
  The pin that when set high will initiate cut down

config CUT_DWN_DUR
  int "Cut Down Duration"
  range 0 10000
  default 1000 
  help
  The duration (ms) cut down gpio needs to be high for cut down. Measured in ms

endmenu
```

## components/DataLogger/Kconfig
```kconfig
menu "SD card config"

config SD1_MOUNT
  string "SD1 Mount"
  default "/sd1"
  help 
  Mount point within esp32 File system for onboard SD card (SD1)

config SD2_MOUNT
  string "SD2 Mount"
  default "/sd2"
  help 
  Mount point within esp32 File system for external SD card (SD2)

endmenu
```

## components/Sensors/Kconfig
```kconfig
menu "Sensors Configuration"
config THERM1_GPIO
  int "Thermistor 1 GPIO"
  range 0 39
  default 36
  help
  GPIO pin for thermistor 1

config THERM2_GPIO
  int "Thermistor 2 GPIO"
  range 0 39
  default 39
  help
  GPIO pin for thermistor 2
  
config THERM1_R1
  int "Thermistor 1 R1"
  range 0 10000000
  default 10000
  help
  The resistance between the voltage source and thermistor 1 in ohms

config THERM2_R1
  int "Thermistor 2 R1"
  range 0 10000000
  default 10000
  help
  The resistance between the voltage source and thermistor 2 in ohms

# config THERM1_VS
#   float "Thermistor 1 voltage source"
#   range 0 5
#   default 3.3
#   help
#   The source voltage going into thermistor 1
#
# config THERM2_VS
#   float "Thermistor 2 voltage source"
#   range 0 5
#   default 3.3
#   help
#   The source voltage going into thermistor 2

# config THERM1_TO
#   float "Thermistor 1 ref temp"
#   range 0 300
#   default 298.15
#   help
#   The reference temperature for thermistor 1 in kelvin
#
# config THERM2_TO
#   float "Thermistor 2 ref temp"
#   range 0 300
#   default 298.15
#   help
#   The reference temperature for thermistor 2 in kelvin

config THERM1_RO
  int "Thermistor 1 ref resistance"
  range 0 10000000
  default 10000
  help
  Thermistor 1 resistance at reference temperature (in ohms)

config THERM2_RO
  int "Thermistor 2 ref resistance"
  range 0 10000000
  default 10000
  help
  Thermistor 2 resistance at reference temperature (in ohms)

config THERM1_B
  int "Thermistor 1 Beta"
  range 0 5000
  default 3575
  help
  Thermistor 1 beta value 

config THERM2_B
  int "Thermistor 2 Beta"
  range 0 5000
  default 3575
  help
  Thermistor 2 beta value

config THERM2_ATTACHED
  bool "Thermistor 2 attached"
  default false
  help
  Is Thermistor 2 physically attached

config THERM_SAMPLE_HZ
  int "Thermistor sample rate"
  default 5
  help
  The sample rate of both thermistor 1 and thermistor 2 in Hz
endmenu
```

## main/Kconfig
```kconfig
menu "General Javelin Config"
  config DATA_LOG_STACK_SZ
   int "Data Logger Stack size"
   default 3072
   help
   The size on the stack allocated at compile time to the datalogger task

  config DATA_LOG_PRIORITY
    int "Data Logger Priority"
    range 1 10
    default 9
    help
    The freeRTOS priority of the data logger task

  config CMD_CNTR_STACK_SZ
    int "Command Center Stack Size"
    default 2048
    help
    The size on the stack allocated at compile time for the command center task

  config CMD_CNTR_PRIORITY
    int "Command Center Priority"
    default 7
    help
    The freeRTOS priority of the command center task

endmenu
```

## mars-javelin-probe/components/ComBus/Kconfig
```kconfig
menu "ComBus Configuration"

config I2C_MASTER_PORT 
  int "I2C Master Port"
  range 0 1 
  default 1 
  help
  Master port number for the I2C bus

config I2C_MASTER_FREQ_HZ
  int "I2C Master frequency"
  range 0 400000
  default 40000
  help
  The speed of the I2C bus for the master

config I2C_SDA_GPIO
  int "I2C SDA GPIO"
  range 0 35
  default 21
  help
  The SDA gpio for the I2C bus

config I2C_SCL_GPIO
  int "I2C SCL GPIO"
  range 0 35
  default 22
  help
  The SCL gpio for the I2C bus

config HSPI_MOSI_GPIO
  int "HSPI MOSI GPIO"
  range 0 35
  default 27
  help
  The MOSI GPIO for the LoRa SPI bus

config HSPI_MISO_GPIO
  int "HSPI MISO GPIO"
  range 0 35
  default 19
  help
  The MISO GPIO for the LoRa SPI bus

config HSPI_SCK_GPIO
  int "HSPI SCK GPIO"
  range 0 35
  default 5
  help
  The SCK GPIO for the LoRa SPI bus

config LORA_CS_GPIO
  int "LORA CS GPIO"
  range 0 35
  default 18
  help
  The CS GPIO for the LoRa SPI bus

config HSPI_RST_GPIO
  int "HSPI RST GPIO"
  range 0 35
  default 23
  help
  The RST GPIO for the LoRa SPI bus

config HSPI_DI0_GPIO
  int "HSPI DI0 GPIO"
  range 0 35
  default 26
  help
  The DI0 GPIO for the LoRa SPI bus

config VSPI_MOSI_GPIO
  int "VSPI MOSI GPIO"
  range 0 35
  default 15
  help
  The MOSI GPIO for the SD card SPI bus

config VSPI_MISO_GPIO
  int "VSPI MISO GPIO"
  range 0 35
  default 2
  help
  The MISO GPIO for the SD card SPI bus

config VSPI_SCK_GPIO
  int "VSPI SCK GPIO"
  range 0 35
  default 14
  help
  The SCK GPIO for the SD card SPI bus

config SD1_CS_GPIO
  int "SD1 CS GPIO"
  range 0 35
  default 13
  help
  The CS GPIO for the onboard (SD1) SD card on SD card SPI bus

config SD2_CS_GPIO
  int "SD2 CS GPIO"
  range 0 35
  default 12
  help
  The CS GPIO for the external (SD2) SD card on the SD card SPI bus


config SD2_ATTACHED
  bool "SD2 Attached"
  default false
  help
  Is the external SD card (SD2) physically attached?

config BME_ATTACHED
  bool "BME280 Attached"
  default false
  help
  Is the BME280 component physically attached?

endmenu
```

## mars-javelin-probe/components/DataLogger/Kconfig
```kconfig
menu "SD Card DataLog Configuration"

config SD1_CS_GPIO
  int "SD1_CS_GPIO"
  range 0 35
  default 13
  help
  Pin number where the CS pin of the onboard SD card module is connected to.

config SD2_CS_GPIO
  int "SD2_CS_GPIO"
  range 0 35
  default 12
  help
  Pin number where the CS pin of the external SD card module is connected to.

config SPI2_MISO_GPIO
  int "SPI_MISO_GPIO"
  range 0 35
  default 2
  help
  Pin number to be used as the MISO signal for SPI 2

config SPI2_MOSI_GPIO
  int "SPI_MOSI_GPIO"
  range 0 35
  default 15
  help
  Pin number to be used as the MOSI signal for SPI 2

config SPI2_SCK_GPIO
  int "SPI2_SCK_GPIO"
  range 0 35
  default 14
  help
  Pin number to be used as the SCK signal ofr SPI 2

config SD1_MOUNT
  string "SD1_MOUNT"
  default "/sd1"
  help 
  Mount point within the file system for SD1

config SD2_MOUNT
  string "SD2_MOUNT"
  default "/sd2"
  help
  Mount point within the file system for SD2

config SD2_ATTACHED
  bool "SD2_ATTACHED"
  default false
  help 
  Is the SD2 card reader physically attached to the SPI bus

endmenu
```
